## boards/shields/miniiris36/Kconfig.defconfig
```kconfig
if SHIELD_MINIIRIS36_LEFT

config ZMK_KEYBOARD_NAME
    default "miniiris36 kbd"

config ZMK_SPLIT_ROLE_CENTRAL
    default y

endif

if SHIELD_MINIIRIS36_LEFT || SHIELD_MINIIRIS36_RIGHT

config ZMK_SPLIT
    default y

endif
```

## boards/shields/miniiris36/Kconfig.shield
```kconfig
config SHIELD_MINIIRIS36_LEFT
    def_bool $(shields_list_contains,miniiris36_left)

config SHIELD_MINIIRIS36_RIGHT
    def_bool $(shields_list_contains,miniiris36_right)
```

## boards/shields/miniiris36_dongle/Kconfig.shield
```kconfig
config SHIELD_MINIIRIS36_DONGLE
    def_bool $(shields_list_contains,miniiris36_dongle)
```
